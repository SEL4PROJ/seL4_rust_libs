## libcompiler-rt/Kconfig
```kconfig
#
# Copyright 2016, NICTA
#
# This software may be distributed and modified according to the terms of
# the BSD 2-Clause license. Note that NO WARRANTY is provided.
# See "LICENSE_BSD2.txt" for details.
#
# @TAG(NICTA_BSD)
#

menuconfig LIB_COMPILER_RT
    bool "libcompiler-rt"
    default y
    help
        "Clangs libcompiler-rt"
```
